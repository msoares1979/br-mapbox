## br-external/Config.in
```kconfig
source "$BR2_EXTERNAL/package/mapbox/Config.in"
source "$BR2_EXTERNAL/package/qt5/Config.in"
```

## br-external/package/mapbox/Config.in
```kconfig
menuconfig BR2_PACKAGE_MAPBOX
	bool "Mapbox packages"
	default y
	depends on BR2_INSTALL_LIBSTDCPP && BR2_USE_WCHAR && (BR2_PACKAGE_HAS_LIBGLES || BR2_PACKAGE_HAS_LIBGL)
	help
	  Mapbox custom packages

	  http://mapbox.com

if BR2_PACKAGE_MAPBOX
	source "$BR2_EXTERNAL/package/mapbox/geometryhpp/Config.in"
	source "$BR2_EXTERNAL/package/mapbox/nunicode/Config.in"
	source "$BR2_EXTERNAL/package/mapbox/variant/Config.in"
	source "$BR2_EXTERNAL/package/mapbox/protozero/Config.in"
	source "$BR2_EXTERNAL/package/mapbox/geojsonvt/Config.in"
	source "$BR2_EXTERNAL/package/mapbox/qmapboxgl/Config.in"
endif

if !BR2_INSTALL_LIBSTDCPP
	comment "Mapbox packages depend on a toolchain with CXX support enabled"
endif

if !BR2_USE_WCHAR
	comment "Mapbox packages depend on a toolchain with WCHAR support enabled"
endif

if !(BR2_PACKAGE_HAS_LIBGLES || BR2_PACKAGE_HAS_LIBGL)
	comment "Mapbox packages depend on OpenGL libgl or libgles support"
endif
```

## br-external/package/mapbox/geojsonvt/Config.in
```kconfig
config BR2_PACKAGE_GEOJSONVT
	bool "geojsonvt"
	default y
	select BR2_PACKAGE_RAPIDJSON
	help
	  Slice GeoJSON into vector tiles on the fly in the browser

	  Port to C++ of JS GeoJSON-VT for slicing GeoJSON into vector tiles on the
	  fly.

	  https://github.com/mapbox/geojson-vt-cpp
```

## br-external/package/mapbox/geometryhpp/Config.in
```kconfig
config BR2_PACKAGE_GEOMETRYHPP
	bool "geometryhpp"
	default y
	help
	  C++ geometry types

	  Provides header-only, generic C++ interfaces for geometry types, geometry
	  collections, and features.

	  https://github.com/mapbox/geometry.hpp
```

## br-external/package/mapbox/nunicode/Config.in
```kconfig
config BR2_PACKAGE_NUNICODE
	bool "nunicode"
	default y
	help
	  Fast, small and portable Unicode library and SQLite3 extension.

	  This is i18n library implementing Unicode 8.0.

	  https://bitbucket.org/alekseyt/nunicode
```

## br-external/package/mapbox/protozero/Config.in
```kconfig
config BR2_PACKAGE_PROTOZERO
	bool "protozero"
	default y
	help
	  Minimalist protocol buffer decoder and encoder in C++

	  Designed for high performance. Suitable for writing zero copy parsers and
	  encoders with minimal need for run-time allocation of memory.

	  https://github.com/mapbox/protozero
```

## br-external/package/mapbox/qmapboxgl/Config.in
```kconfig
menuconfig BR2_PACKAGE_QMAPBOXGL
	bool "qmapboxgl"
	select BR2_PACKAGE_BOOST
	select BR2_PACKAGE_QT5
	select BR2_PACKAGE_GTEST
	select BR2_PACKAGE_OPENSSL
	default y
	help
	  A library for embedding interactive, customizable vector maps.

	  https://github.com/mapbox/mapbox-gl-native

if BR2_PACKAGE_QMAPBOXGL

config BR2_PACKAGE_QMAPBOXGL_GLES2
	bool "Enable GLES2 support"

endif
```

## br-external/package/mapbox/variant/Config.in
```kconfig
config BR2_PACKAGE_VARIANT
	bool "variant"
	default y
	help
	  An alternative to boost::variant for C++11.

	  https://github.com/mapbox/variant
```
